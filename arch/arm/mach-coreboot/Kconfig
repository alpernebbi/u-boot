## arch/arm/mach-coreboot/Kconfig
```kconfig
if ARCH_COREBOOT

config SYS_VENDOR
	default "coreboot"

config SYS_BOARD
	default "coreboot-arm"

config SYS_CONFIG_NAME
	default "coreboot-arm"

choice
	prompt "coreboot ARM architecture"
	default TARGET_COREBOOT_ARM_64BIT

config TARGET_COREBOOT_ARM_32BIT
	bool "Coreboot payload on ARMv7-A, 32bit"
	select ARCH_SUPPORT_PSCI
	select BOARD_LATE_INIT
	select CPU_V7A
	select SYS_ARCH_TIMER

config TARGET_COREBOOT_ARM_64BIT
	bool "Coreboot payload on ARMv8, 64bit"
	select ARM64
	select BOARD_LATE_INIT

endchoice

endif
```

## board/coreboot/coreboot-arm/Kconfig
```kconfig
if TARGET_COREBOOT_ARM_32BIT || TARGET_COREBOOT_ARM_64BIT

config TEXT_BASE
	default 0x50000000

config BOARD_SPECIFIC_OPTIONS # dummy
	def_bool y
endif

config PRE_CON_BUF_ADDR
	hex
	default 0x40100000

if TARGET_QEMU_ARM_64BIT && !TFABOOT

config BOARD_SPECIFIC_OPTIONS
	imply SYS_MTDPARTS_RUNTIME
	imply SET_DFU_ALT_INFO

endif
```

## configs/coreboot-arm64_defconfig
```kconfig
CONFIG_ARM=y
CONFIG_SKIP_LOWLEVEL_INIT=y
CONFIG_SKIP_LOWLEVEL_INIT_ONLY=y
CONFIG_ARCH_COREBOOT=y
CONFIG_SYS_MALLOC_LEN=0x1000000
CONFIG_NR_DRAM_BANKS=1
CONFIG_ENV_SIZE=0x40000
CONFIG_DM_GPIO=y
CONFIG_DEFAULT_DEVICE_TREE="mediatek/mt8186-corsola-magneton-sku393218"
CONFIG_ARMV8_CRYPTO=y
CONFIG_SYS_LOAD_ADDR=0x40200000
CONFIG_SYS_PCI_64BIT=y
CONFIG_PCI=y
CONFIG_AHCI=y
CONFIG_CC_OPTIMIZE_FOR_DEBUG=y
CONFIG_FIT=y
CONFIG_FIT_SIGNATURE=y
CONFIG_FIT_VERBOSE=y
CONFIG_FIT_BEST_MATCH=y
CONFIG_BOOTSTD_FULL=y
CONFIG_LEGACY_IMAGE_FORMAT=y
# CONFIG_USE_BOOTCOMMAND is not set
CONFIG_USE_PREBOOT=y
CONFIG_CONSOLE_RECORD=y
CONFIG_SYS_CBSIZE=512
CONFIG_SYS_PBSIZE=532
CONFIG_LOGLEVEL=9
CONFIG_LOG_MAX_LEVEL=9
CONFIG_LOG_ERROR_RETURN=y
# CONFIG_DISPLAY_CPUINFO is not set
CONFIG_DISPLAY_BOARDINFO_LATE=y
CONFIG_PCI_INIT_R=y
CONFIG_CMD_BDINFO_EXTRA=y
CONFIG_CMD_SMBIOS=y
CONFIG_CMD_BOOTZ=y
CONFIG_CMD_BOOTEFI_SELFTEST=y
CONFIG_CMD_NVEDIT_EFI=y
CONFIG_CMD_MEMINFO=y
CONFIG_CMD_MTD=y
CONFIG_CMD_PCI=y
CONFIG_CMD_CACHE=y
CONFIG_CMD_TPM=y
CONFIG_CMD_CBSYSINFO=y
CONFIG_CMD_EVENT=y
CONFIG_CMD_LOG=y
CONFIG_OF_UPSTREAM=y
CONFIG_OF_EMBED=y
# CONFIG_OF_BOARD is not set
CONFIG_DM_STATS=y
CONFIG_SCSI_AHCI=y
CONFIG_AHCI_PCI=y
CONFIG_ROCKCHIP_GPIO=y
CONFIG_DM_I2C=y
CONFIG_SYS_I2C_ROCKCHIP=y
CONFIG_CROS_EC_KEYB=y
CONFIG_CROS_EC=y
CONFIG_CROS_EC_I2C=y
CONFIG_CROS_EC_SPI=y
# CONFIG_MMC is not set
CONFIG_MTD=y
CONFIG_DM_MTD=y
CONFIG_MTD_NOR_FLASH=y
CONFIG_FLASH_SHOW_PROGRESS=0
CONFIG_CFI_FLASH=y
CONFIG_CFI_FLASH_USE_WEAK_ACCESSORS=y
CONFIG_SYS_FLASH_USE_BUFFER_WRITE=y
CONFIG_FLASH_CFI_MTD=y
CONFIG_SYS_FLASH_CFI=y
CONFIG_SYS_MAX_FLASH_SECT=256
CONFIG_SYS_MAX_FLASH_BANKS=2
CONFIG_SYS_MAX_FLASH_BANKS_DETECT=y
CONFIG_E1000=y
CONFIG_NVME_PCI=y
CONFIG_PCI_REGION_MULTI_ENTRY=y
CONFIG_PCIE_ECAM_GENERIC=y
CONFIG_PINCTRL=y
CONFIG_PINCTRL_ROCKCHIP_RV1108=y
# CONFIG_RTC_PL031 is not set
CONFIG_SCSI=y
# CONFIG_REQUIRE_SERIAL_CONSOLE is not set
CONFIG_SPI=y
CONFIG_DM_SPI=y
CONFIG_ROCKCHIP_SPI=y
CONFIG_SYSRESET=y
CONFIG_SYSRESET_CMD_POWEROFF=y
CONFIG_SYSRESET_PSCI=y
CONFIG_TPM2_MMIO=y
CONFIG_USB_EHCI_HCD=y
CONFIG_USB_EHCI_PCI=y
CONFIG_VIDEO_PCI_DEFAULT_FB_SIZE=0x800000
CONFIG_NO_FB_CLEAR=y
CONFIG_PANIC_HANG=y
CONFIG_ACPI=y
CONFIG_TPM=y
CONFIG_EFI_VARIABLE_NO_STORE=y
```
