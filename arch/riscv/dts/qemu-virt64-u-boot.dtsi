// SPDX-License-Identifier: GPL-2.0+
/*
 * Copyright (C) 2021, Bin Meng <bmeng.cn@gmail.com>
 */

#include "binman.dtsi"

/ {
	fw-cfg@10100000 {
		bootph-some-ram;

		qfw-ramfb {
			compatible = "qemu,qfw-ramfb";
			bootph-some-ram;
		};
	};
};
